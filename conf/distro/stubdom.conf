## conf/distro/stubdom.conf
```bitbake
PREFERRED_PROVIDER_virtual/kernel = "linux-stubdom-qubes"

NO_RECOMMENDATIONS = "1"
```

## conf/layer.conf
```bitbake
# We have a conf and classes directory, add to BBPATH
BBPATH .= ":${LAYERDIR}"

# We have recipes-* directories, add to BBFILES
BBFILES += "${LAYERDIR}/recipes-*/*/*.bb ${LAYERDIR}/recipes-*/*/*.bbappend"

BBFILE_COLLECTIONS += "xen-stubdom-linux"
BBFILE_PATTERN_xen-stubdom-linux = "^${LAYERDIR}/"
BBFILE_PRIORITY_xen-stubdom-linux = "1"

# This should only be incremented on significant changes that will
# cause compatibility issues with other layers
LAYERVERSION_xen-stubdom-linux = "1"

LAYERDEPENDS_xen-stubdom-linux = " \
    core \
    virtualization-layer \
"

LAYERSERIES_COMPAT_xen-stubdom-linux = "thud"
```

## conf/machine/xen-stubdom.conf
```bitbake
require conf/machine/include/tune-core2.inc

MACHINE_FEATURES = "ethernet pci x86"

KERNEL_IMAGETYPE = "bzImage"

DEFAULTTUNE = "core2-64"
```
